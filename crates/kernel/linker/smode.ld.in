/* ==========================================================================
 * crates/kernel/linker/smode.ld.in -- 内核链接脚本模板 (S-mode 交接布局)
 * --------------------------------------------------------------------------
 * 这个脚本回答一个非常具体的问题: "内核的各个段应该被放在内存的什么位置?"
 *
 * 【它为什么叫 smode 而不是 sbi / uboot】
 *
 * 因为脚本编码的是**布局方式**, 不是某个具体 bootloader 的名字:
 *
 *     固件已经把内核放到一个固定物理地址, 然后直接跳到入口 ——
 *     所以脚本只需要声明入口符号与段的顺序, 不需要任何特殊段。
 *
 * OpenSBI (QEMU) 与 U-Boot (VisionFive2) 走的都是这条路, 所以它们
 * **共用这一份脚本**。按 bootloader 名字拆成两份会立刻变成"必须永远
 * 保持同步的重复代码" —— 而这类重复迟早会不一致, 且症状出现在没改
 * 的那一侧 (本项目在定时器驱动上刚踩过一次同样的坑)。
 *
 * 真正需要独立脚本的是**布局不同**的启动协议:
 *
 *     multiboot   文件头 8 KiB 内必须有可被 4 字节对齐找到的
 *                 multiboot header 段
 *     UEFI        产物是 PE/COFF, 节的对齐与命名有额外要求
 *     limine      需要 limine requests 段, 且对段顺序敏感
 *
 * 加一个这样的协议: 在本目录写 <协议>.ld.in, 然后在 configs/*.toml 里
 * 把 `linker` 指过去。构建脚本一行都不用改 —— 它只读配置里那个路径。
 *
 * 【@KERNEL_BASE@ 由 build.rs 替换】
 *   链接基地址是**平台**的事实 (QEMU 是 0x80200000, VF2 是 0x40200000),
 *   而脚本的组织方式是**架构**的事实 (OUTPUT_ARCH、段的对齐要求)。
 *   所以模板放在 arch 相关的位置, 而具体的数值由构建系统注入 ——
 *   数值来自 configs/*.toml 的 kernel_load_addr。
 *
 *   这与 C 版本用 --defsym 的效果相同, 但有一个额外的好处:
 *   生成的脚本里那个地址是一个**字面量**, 会被 build.rs 同时写进
 *   Rust 常量 (platform_facts::CONFIG_KERNEL_LOAD_ADDR),
 *   于是内核可以在启动时自检
 *       "我的 _entry 实际地址 == platform 层声明的 kernel_base 吗?"
 *   用 --defsym 的话这个值只活在链接器里, 内核看不见它。
 *
 * 【链接地址必须等于加载地址】
 *   本内核使用恒等映射 (虚拟地址 == 物理地址), 所以链接地址就是
 *   加载地址。两者不一致时, 内核里所有的绝对地址访问 (取全局变量、
 *   取字符串字面量) 都会偏掉 —— 症状可能是"打印出半句话然后卡死"
 *   这种极难定位的现象。
 *
 *   启动代码里有三道防线:
 *     1. 链接期: 链接器在 _entry 未落在基地址时会报错 (见下方 ASSERT)
 *     2. 编译期: platform 层的 static_assert 检查常量之间的关系
 *     3. 启动期: kernel_entry 比较 &_entry 与 platform.kernel_base
 * ========================================================================== */

OUTPUT_ARCH(@KERNEL_ARCH@)
ENTRY(@ENTRY_SYMBOL@)

SECTIONS
{
  /* 基地址由构建系统注入 (见 crates/kernel/build.rs)。 */
  . = @KERNEL_BASE@;

  /* ------------------------------------------------------------------
   * 入口代码
   * ------------------------------------------------------------------
   * `_entry` 必须**位于镜像的最前面**。原因: 固件/加载器可能从
   * 镜像的第一个字节开始执行 (例如 U-Boot 的 `go` 命令)。
   * 把 .text.entry 放在最前面, 让"镜像起点 == 入口"成为事实,
   * 而不是一个需要加载器配合的约定。
   * ------------------------------------------------------------------ */
  .text : ALIGN(4) {
    KEEP(*(.text.entry))
    *(.text .text.*)
    . = ALIGN(4);
  }

  /* ------------------------------------------------------------------
   * 只读数据
   * ------------------------------------------------------------------
   * 字符串字面量、常量表都在这里。注意它必须在 .text 之后、
   * .data 之前: 有些加载器 (以及我们的 objcopy -> .bin 流程)
   * 按段顺序排列, 混序会让镜像里出现不必要的空洞。
   * ------------------------------------------------------------------ */
  .rodata : ALIGN(16) {
    *(.srodata .srodata.*)
    . = ALIGN(16);
    *(.rodata .rodata.*)
  }

  /* ------------------------------------------------------------------
   * 已初始化数据
   * ------------------------------------------------------------------ */
  .data : ALIGN(16) {
    _data_start = .;
    *(.sdata .sdata.*)
    . = ALIGN(16);
    *(.data .data.*)
    _data_end = .;
  }

  /* ------------------------------------------------------------------
   * 未初始化数据 (.bss)
   * ------------------------------------------------------------------
   * 【bss 必须由内核自己清零, 不能依赖加载器】
   *   * QEMU 用 -device loader 加载 ELF 时只写 PT_LOAD 段里文件
   *     大小之内的部分;
   *   * U-Boot 的 bootm 搬运的是 objcopy 出来的裸二进制, 而
   *     objcopy 默认**不包含** .bss (它没有文件内容)。
   *   也就是说在 VF2 上 .bss 里可能是任意垃圾。
   *
   * 所以 _entry 里有一段汇编专门清 .bss, 它需要 __bss_start /
   * __bss_end 这两个符号。
   * ------------------------------------------------------------------ */
  .bss : ALIGN(16) {
    __bss_start = .;
    *(.sbss .sbss.*)
    . = ALIGN(16);
    *(.bss .bss.*)
    *(COMMON)
    . = ALIGN(16);
    __bss_end = .;
  }

  /* ------------------------------------------------------------------
   * 内核栈
   * ------------------------------------------------------------------
   * 【为什么栈由链接脚本分配, 而不是放在 .bss 里的一个 Rust 数组】
   *
   * 两个原因:
   *   1. 汇编入口需要在**任何 Rust 代码运行之前**就能算出栈顶,
   *      而访问一个 Rust 静态变量需要它的符号地址 —— 那也可以,
   *      但用链接脚本分配的符号更直接, 而且不依赖 Rust 的类型布局。
   *   2. 栈必须页对齐 (页表映射时会按页授予权限), 而 Rust 数组的
   *      对齐只能保证到 16 字节。链接脚本的 ALIGN 更精确。
   *
   * 槽位数量 = ncpu + 1, 由 build.rs 生成 —— 见那里对"为什么多一页"
   * 的说明 (用一页内存换一个可诊断的失败模式)。
   *
   * 【这里必须用 /DISCARD/ 之前的位置】
   * 栈在 .bss 之后分配, 于是 _kernel_end 会把它算进去 ——
   * 物理页分配器从 _kernel_end 开始, 自然不会覆盖栈。
   * ------------------------------------------------------------------ */
  . = ALIGN(@PAGE_SIZE@);
  boot_stacks = .;
  . += (@STACK_SIZE_BYTES@ * @STACK_SLOTS@);
  /* 栈 canary 数组: 每个 hart 一个 usize, 紧跟在内核栈之后。 */
  . = ALIGN(8);
  stack_canaries = .;
  . += (8 * @STACK_SLOTS@);

  /* ------------------------------------------------------------------
   * 物理内存分配器的起点
   * ------------------------------------------------------------------
   * _kernel_end 之后的内存才允许被物理页分配器管理。
   * 这个符号被 kernel 的内存模块使用。
   * ------------------------------------------------------------------ */
  . = ALIGN(@PAGE_SIZE@);
  PROVIDE(_kernel_end = .);
  PROVIDE(ALLOC_BEGIN = .);

  /* ------------------------------------------------------------------
   * 镜像结束标记
   * ------------------------------------------------------------------ */
  PROVIDE(_image_end = .);

  /* ------------------------------------------------------------------
   * 丢弃不需要的段
   * ------------------------------------------------------------------
   * .eh_frame: Rust/C++ 的栈展开表。我们用 panic=abort, 不需要它,
   *            留着会让镜像白白大几十 KB。
   * .comment:  编译器版本字符串。
   *
   * 注意**不要**丢弃 .got / .plt: 即使 -mcmodel=medany 生成了
   * GOT, 丢掉它们会让链接器报 "relocation truncated" —— 那时的
   * 错误信息与真正的原因 (丢了一个必要的段) 看起来毫无关系。
   * ------------------------------------------------------------------ */
  /DISCARD/ : {
    *(.eh_frame)
    *(.eh_frame_hdr)
    *(.comment)
    *(.note.GNU-stack)
  }

  /* ------------------------------------------------------------------
   * 链接期断言 —— 定义式 (declarative) 的检查
   * ------------------------------------------------------------------
   * 这些断言让"布局错了"变成链接错误, 而不是运行期的诡异行为。
   * ------------------------------------------------------------------ */

  /* 1. 内核起点必须等于配置的加载地址。
   *    如果 _entry 被别的东西顶到了后面 (例如有人往 .text.entry
   *    之前塞了一个段), 这条会失败。 */
  ASSERT(@ENTRY_SYMBOL@ == @KERNEL_BASE@,
         "错误: 入口点不在配置的加载地址上。检查 .text.entry 是否被其他段顶到了后面。")

  /* 2. 内核不能太大, 以至于越过 DRAM 的 1/4 —— 那说明链接地址或
   *    段布局出了问题 (例如 .bss 里有一个巨大的静态数组)。
   *    用 1/4 而不是整个 DRAM, 是为了给物理页分配器和用户程序
   *    留出空间。 */
  ASSERT((_image_end - @KERNEL_BASE@) < (128 * 1024 * 1024 / 4),
         "错误: 内核镜像异常大 (>32 MiB)。检查是否误定义了巨大的静态数组。")

  /* 3. 内核栈必须页对齐。 */
  ASSERT(boot_stacks % @PAGE_SIZE@ == 0,
         "错误: boot_stacks 没有页对齐 —— 页表映射会出错。")

  /* 4. 入口点必须是 4 字节对齐的 —— RISC-V 指令是 4 字节 (或
   *    压缩指令 2 字节, 但入口点必须至少 4 字节对齐,
   *    因为 stvec/加载器都会这样要求)。 */
  ASSERT(@ENTRY_SYMBOL@ % 4 == 0, "错误: 入口点没有 4 字节对齐。")
}
