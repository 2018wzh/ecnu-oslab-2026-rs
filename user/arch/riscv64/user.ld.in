/* ============================================================================
 * user/arch/riscv64/user.ld.in -- 用户程序的链接脚本**模板**
 * ----------------------------------------------------------------------------
 * 【为什么是模板而不是成品脚本】
 * 与内核的 kernel.ld 同理: 脚本里有两个值跟着架构走 ——
 *
 *     @ARCH_NAME@   OUTPUT_ARCH 的机器名 (binutils 的词汇)
 *     @USER_BASE@   内核装入用户程序时的基址
 *
 * 写死在脚本里, 换架构 (或者改内核的装入基址) 就得改这个文件;
 * 而它是**架构目录**下的文件, 不该同时承担"装入地址"这个 ABL 事实。
 * 现在这两个值来自 configs/arch/<arch>.toml, 由 xtask 替换后生成
 * target/user/user.ld (成品脚本不进仓库)。
 *
 * 用户程序的入口符号 `_user_start` **不是**占位符: 它是内核与用户态
 * 之间的 ABI 约定 (见 crates/uapi/src/lib.rs 的 USER_ENTRY_SYMBOL),
 * 换架构时它不变。
 * ----------------------------------------------------------------------------
 * 【这个脚本与内核的 kernel.ld 有三处关键差别, 每一处都有原因】
 *
 *   1. 基地址不同
 *      内核: 0x80200000 (QEMU) / 0x40200000 (VF2) —— 由固件决定, 每个平台不同
 *      用户: 0x1000 —— 由【内核的加载器】决定, 与平台无关
 *
 *      用户程序从 0x1000 开始而不是 0 的原因: 内核故意不映射第 0 页,
 *      这样用户程序里的"空指针解引用"会立刻变成缺页异常, 而不是
 *      静默地读到有效内存。让 bug 尽早、以明确的方式暴露出来。
 *
 *   2. 没有 trampoline 段
 *      那是内核在用户态/内核态之间切换时用的公共代码页, 用户程序不需要。
 *
 *   3. 保留 .bss 并显式清零
 *      用户程序的 .bss 必须由【内核加载器】清零 (磁盘/映像上不存零)。
 *      见 kernel 侧 exec 的实现。
 * ============================================================================ */

OUTPUT_ARCH(@ARCH_NAME@)
ENTRY(_user_start)

/* ============================================================================
 * 【一条关键约束: 段之间不能有大洞】
 *
 * 内核是按**字节**把 .bin 映像从 USER_BASE 连续装入的 —— 它不做
 * 段到段的搬运 (那需要解析 ELF program header, 属于 lab-9 的内容)。
 *
 * 所以这里必须保证"文件里的偏移"与"虚拟地址的偏移"一致:
 *
 *     va - USER_BASE == 文件内偏移
 *
 * 曾经在 .text 末尾写了一行 `. = ALIGN(0x1000)`, 于是 .rodata 被推到
 * 0x2000, 而 .text 大约结束在 0x11e5 —— 中间 3.5 KB 的空洞在文件里
 * **不存在**。后果是 .rodata 的内容被装到了 0x11e5 附近, 而程序仍然
 * 按 0x2000 去取字符串:
 *
 *   * 前几条 ecall 用的是**错的**参数 (a7 读成了别的值, 表现为
 *     "getpid 的调用号变成了 write");
 *   * 更迷惑的是程序"部分正确"—— 后面某处的字符串恰好落在对的位置,
 *     于是能打印出一部分输出。
 *
 * 症状是"用户程序行为错乱但没崩", 极难定位。教训: 对"按字节装入"
 * 的映像, 链接脚本里不要出现会把地址推走的 ALIGN, 除非同时保证
 * 文件里也有对应的填充 (用 `FILL` 或 `BYTE(0)`)。
 * ============================================================================ */

SECTIONS
{
    . = @USER_BASE@;

    /* ---- 代码 ----
     * 入口点放最前面: 内核只按符号找入口, 但这个顺序让 objdump 更易读。 */
    .text : {
        /* 【入口必须排在 .text 的最前面】
         *
         * 内核把映像装到 USER_BASE (0x1000) 之后,**直接跳过去执行** ——
         * 它不解析 ELF 的入口地址 (那属于 lab-9 的 ELF 加载器)。
         *
         * 所以 0x1000 处必须是 `_user_start`。
         *
         * 曾经这里写的是 `*(.text.entry)`, 而 Rust 编译产物里**没有**
         * 这个名字的段 —— 于是这一行什么都没选中, 链接器按默认顺序
         * 把 `.text` 的第一块放了上去。结果 0x1000 处是
         * `rust_begin_unwind` (panic 处理函数), 用户程序一进去就
         * 打印 "[user] panic: " 然后崩在 addr=0x8。
         *
         * 现象是"用户程序什么都没干就 panic", 与真正的原因
         * (入口排在了错误的位置) 相距极远。
         *
         * 用 `KEEP` 是必要的: 链接器的 --gc-sections 可能认为
         * `_user_start` 没有被引用而把它回收掉。
         */
        KEEP(*(.text._user_start))
        KEEP(*(.text.entry))
        *(.text .text.*)
    }

    /* ---- 只读数据 ---- */
    .rodata : {
        . = ALIGN(16);
        *(.srodata .srodata.*)
        . = ALIGN(16);
        *(.rodata .rodata.*)
    }

    /* ---- 已初始化数据 ---- */
    .data : {
        . = ALIGN(16);
        *(.sdata .sdata.*)
        . = ALIGN(16);
        *(.data .data.*)
    }

    /* ---- 未初始化数据 ----
     * 【为什么要把起止地址导出给链接器符号】
     * 因为内核加载器需要知道"哪一段要清零"。映像文件里 .bss 不占空间
     * (它全是零, 存了也是浪费), 所以加载器必须根据这两个符号算出
     * 范围并显式清零。忘了这一步的症状是: 全局变量初值不是 0 而是
     * 内存里的随机残留 —— 那会是非常难查的一类 bug。 */
    .bss : {
        . = ALIGN(16);
        _bss_start = .;
        *(.sbss .sbss.*)
        . = ALIGN(16);
        *(.bss .bss.*)
        *(COMMON)
        . = ALIGN(16);
        _bss_end = .;
    }

    /* 记录映像末尾, 便于内核校验映像大小 */
    _user_image_end = .;

    /DISCARD/ : {
        *(.eh_frame)
        *(.comment)
        *(.note .note.*)
    }
}
